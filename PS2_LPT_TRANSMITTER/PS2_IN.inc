-- WARNING: Do NOT edit the input and output ports in this file in a text
-- editor if you plan to continue editing the block that represents it in
-- the Block Editor! File corruption is VERY likely to occur.

-- Copyright (C) 1991-2009 Altera Corporation
-- Your use of Altera Corporation's design tools, logic functions 
-- and other software and tools, and its AMPP partner logic 
-- functions, and any output files from any of the foregoing 
-- (including device programming or simulation files), and any 
-- associated documentation or information are expressly subject 
-- to the terms and conditions of the Altera Program License 
-- Subscription Agreement, Altera MegaCore Function License 
-- Agreement, or other applicable license agreement, including, 
-- without limitation, that your use is for the sole purpose of 
-- programming logic devices manufactured by Altera and sold by 
-- Altera or its authorized distributors.  Please refer to the 
-- applicable agreement for further details.


-- Generated by Quartus II Version 9.0 (Build Build 235 06/17/2009)
-- Created on Mon Mar 21 11:42:47 2011

FUNCTION PS2_IN (GEN, RESET, ADDR[7..0], IORQ, RD, PDATA_IN[7..0])
	RETURNS (DATA[7..0], WAIT, PS2_DEBUG_PORT[7..0], PD_1[7..0], F_U[7..0], F_D[7..0], PDATA_OUT[7..0]);
