-- WARNING: Do NOT edit the input and output ports in this file in a text
-- editor if you plan to continue editing the block that represents it in
-- the Block Editor! File corruption is VERY likely to occur.

-- Copyright (C) 1991-2009 Altera Corporation
-- Your use of Altera Corporation's design tools, logic functions 
-- and other software and tools, and its AMPP partner logic 
-- functions, and any output files from any of the foregoing 
-- (including device programming or simulation files), and any 
-- associated documentation or information are expressly subject 
-- to the terms and conditions of the Altera Program License 
-- Subscription Agreement, Altera MegaCore Function License 
-- Agreement, or other applicable license agreement, including, 
-- without limitation, that your use is for the sole purpose of 
-- programming logic devices manufactured by Altera and sold by 
-- Altera or its authorized distributors.  Please refer to the 
-- applicable agreement for further details.


-- Generated by Quartus II Version 9.0 (Build Build 235 06/17/2009)
-- Created on Sat Mar 19 19:51:29 2011

FUNCTION LPT_OUT (GEN, RESET, A[7..0], D[7..0], IORQ, WR, STEP_SW0, LSTAT[7..0])
	RETURNS (WAIT, V_BPRINT, V_APRINT, V_CSTIME[5..0], V_Z[7..0], V_D2[7..0], V_D1[7..0], V_D0[7..0], LCTRL[7..0], LDATASYN[7..0]);
